## components/sd_card/Kconfig.projbuild
```kconfig
menu "SD Card Configuration"
    
    config SDSPI_MOUNT_POINT
        string "SD card mount point"
        default "/sdcard"
        help
            Path where the SD card will be mounted in the VFS.  

    config SDSPI_BUS_HOST
        int "SD SPI host (spi_host_device_t)"
        range 1 2
        default 2
        help
            SPI host used for the SD card interface.

    config SDSPI_MAX_FREQ_KHZ
        int "SD SPI clock (KHz)"
        range 400 25000
        default 20000
        help
            Clock frequency for the SD card SPI interface.    
        
    config SDSPI_BUS_MISO_GPIO
        int "SD SPI MISO GPIO"
        range -1 47
        default -1
        help 
            GPIO number for MISO line of the SD card SPI bus.

    config SDSPI_BUS_MOSI_GPIO
        int "SD SPI MOSI GPIO"
        range -1 47
        default -1
        help
            GPIO number for MOSI line of the SD card SPI bus.

    config SPSPI_BUS_SCL_GPIO
        int "SD SPI SCLK GPIO"
        range -1 47
        default -1   
        help
            GPIO number for SCLK line of the SD card SPI bus.     

    config SDSPI_DEVICE_CS_GPIO
        int "SD card CS GPIO"
        range -1 47
        default -1
        help
            GPIO number for the SD card chip-select pin.

endmenu
```

## main/Kconfig.projbuild
```kconfig
menu "App Settings"
    config APP_ENABLE_HEAP_STATS
        bool "Enable heap stats task"
        default n
        help
          When enabled, starts the periodic heap logging task.

    config APP_ENABLE_DUAL_CORE
      bool "Enable dual core"
      default n
      help
        When enabled, it uses both cores to run tasks. Mainly used for heap stats task.          

endmenu
```

## sdkconfig.defaults
```kconfig
CONFIG_ESP_DEFAULT_CPU_FREQ_MHZ_240=y
CONFIG_ESP_DEFAULT_CPU_FREQ_MHZ=240
CONFIG_APP_ENABLE_HEAP_STATS=y

# === Build / Toolchain ===
# [FPS CRITICAL]
CONFIG_COMPILER_OPTIMIZATION_PERF=y              

# === Flash & Partitions ===
CONFIG_ESPTOOLPY_FLASHMODE_QIO=y
CONFIG_ESPTOOLPY_FLASHSIZE_4MB=y                 
CONFIG_ESPTOOLPY_FLASHSIZE="4MB"
CONFIG_PARTITION_TABLE_CUSTOM=y                   
CONFIG_PARTITION_TABLE_CUSTOM_FILENAME="partitions_modified.csv"
CONFIG_PARTITION_TABLE_FILENAME="partitions_modified.csv"         

# === LVGL – core / OS / libc ===
CONFIG_LV_USE_CLIB_MALLOC=y                       
CONFIG_LV_USE_CLIB_STRING=y
CONFIG_LV_USE_CLIB_SPRINTF=y
CONFIG_LV_OS_FREERTOS=y                           
CONFIG_LV_USE_FREERTOS_TASK_NOTIFY=y       
CONFIG_LV_DRAW_THREAD_STACK_SIZE=12288       

# === LVGL – performance / rendering ===
# 20 ms tick target (~50 Hz) [FPS CRITICAL]
CONFIG_LV_DEF_REFR_PERIOD=20      
# Two draw units (parallelism) [FPS CRITICAL]                
CONFIG_LV_DRAW_SW_DRAW_UNIT_CNT=2     
# Hot code in IRAM (faster draw) [FPS CRITICAL]            
CONFIG_LV_ATTRIBUTE_FAST_MEM_USE_IRAM=y           

# === LVGL - filesystem & image decoders ===
CONFIG_LV_USE_FS_STDIO=y
CONFIG_LV_FS_STDIO_LETTER=83
CONFIG_LV_FS_STDIO_PATH="/sdcard"
CONFIG_LV_FS_STDIO_CACHE_SIZE=0
CONFIG_LV_USE_TJPGD=y
CONFIG_LV_USE_FS_FATFS=n
CONFIG_LV_USE_BMP=n
CONFIG_LV_USE_LODEPNG=n

# === Display Interface (SPI) ===
CONFIG_BSP_DISPLAY_ENABLED=y                      
CONFIG_BSP_DISPLAY_INTERFACE_SPI=y                
CONFIG_BSP_DISPLAY_CS_GPIO=14
CONFIG_BSP_DISPLAY_RST_GPIO=13
CONFIG_BSP_DISPLAY_DC_GPIO=12
CONFIG_BSP_DISPLAY_MOSI_GPIO=11
CONFIG_BSP_DISPLAY_SCLK_GPIO=10
CONFIG_BSP_DISPLAY_BACKLIGHT_GPIO=9
CONFIG_BSP_DISPLAY_MISO_GPIO=46
CONFIG_BSP_DISPLAY_ROTATION_SWAP_XY=n
CONFIG_BSP_DISPLAY_ROTATION_MIRROR_X=y
CONFIG_BSP_DISPLAY_ROTATION_MIRROR_Y=y


# === Display – orientation & color ===
CONFIG_BSP_DISPLAY_ROTATION_SWAP_XY=y             
CONFIG_BSP_DISPLAY_COLOR_SPACE_BGR=y              

# === BSP Display – panel & enablement ===
CONFIG_BSP_DISPLAY_DRIVER_ILI9341=y   
# SPI pixel clock (MHz) [FPS CRITICAL]            
CONFIG_BSP_DISPLAY_PIXEL_CLOCK=40    
# Draw buffer height (lines) [FPS CRITICAL]             
CONFIG_BSP_LCD_DRAW_BUF_HEIGHT=60  
# Double buffering [FPS CRITICAL]               
CONFIG_BSP_LCD_DRAW_BUF_DOUBLE=y                  

# === XPT2046 Touch Controller ===          
CONFIG_TOUCH_SPI_HOST=1
CONFIG_TOUCH_SPI_HZ=2000000
CONFIG_TOUCH_CS_GPIO=8
CONFIG_TOUCH_SPI_SCLK_GPIO=10
CONFIG_TOUCH_SPI_MOSI_GPIO=11
CONFIG_TOUCH_IRQ_GPIO=16
CONFIG_TOUCH_SPI_MISO_GPIO=46
CONFIG_TOUCH_RST_GPIO=-1
CONFIG_TOUCH_SWAP_XY=n
CONFIG_TOUCH_MIRROR_X=n
CONFIG_TOUCH_MIRROR_Y=n
CONFIG_XPT2046_Z_THRESHOLD=400

# === SD Card ===   
CONFIG_SDSPI_MOUNT_POINT="/sdcard"
CONFIG_SDSPI_BUS_HOST=2
CONFIG_SDSPI_MAX_FREQ_KHZ=20000
CONFIG_SDSPI_DEVICE_CS_PIN=35
CONFIG_SPSPI_BUS_SCL_PIN=36
CONFIG_SDSPI_BUS_MOSI_PIN=37
CONFIG_SDSPI_BUS_MISO_PIN=38

# === FATFS ===
CONFIG_FATFS_VFS_FSTAT_BLKSIZE=4096
CONFIG_FATFS_LFN_HEAP=y
CONFIG_FATFS_MAX_LFN=255

# === Wi-Fi / LWIP footprint tweaks (for one-shot SNTP) ===
CONFIG_ESP_WIFI_STATIC_RX_BUFFER_NUM=8
CONFIG_ESP_WIFI_DYNAMIC_RX_BUFFER_NUM=12
CONFIG_ESP_WIFI_STATIC_TX_BUFFER=y
CONFIG_ESP_WIFI_TX_BUFFER_TYPE=0
CONFIG_ESP_WIFI_STATIC_TX_BUFFER_NUM=4
# CONFIG_ESP_WIFI_DYNAMIC_TX_BUFFER is not set
# CONFIG_ESP_WIFI_IRAM_OPT is not set
# CONFIG_ESP_WIFI_RX_IRAM_OPT is not set
# CONFIG_ESP_WIFI_ENABLE_WPA3_SAE is not set
# CONFIG_ESP_WIFI_ENABLE_SAE_PK is not set
# CONFIG_ESP_WIFI_ENABLE_SAE_H2E is not set
# CONFIG_ESP_WIFI_ENABLE_WPA3_OWE_STA is not set
# CONFIG_ESP_WIFI_SOFTAP_SUPPORT is not set
# CONFIG_ESP_WIFI_ENTERPRISE_SUPPORT is not set

CONFIG_LWIP_MAX_SOCKETS=3
CONFIG_LWIP_MAX_ACTIVE_TCP=3
CONFIG_LWIP_MAX_LISTENING_TCP=2
CONFIG_LWIP_MAX_UDP_PCBS=6
CONFIG_LWIP_MAX_RAW_PCBS=2
CONFIG_LWIP_TCPIP_RECVMBOX_SIZE=12
# CONFIG_LWIP_DNS_SUPPORT_MDNS_QUERIES is not set
# CONFIG_LWIP_DHCPS is not set
# CONFIG_LWIP_IPV6 is not set
# CONFIG_LWIP_ND6 is not set
# CONFIG_LWIP_IP6_FRAG is not set
CONFIG_LWIP_DNS_MAX_SERVERS=2
```
